VERSION ""

NS_ :

BS_:

BU_:

BO_ 3 New_Message_1: 2 Vector__XXX
 SG_ New_Signal_3 : 0|16@1- (1,0) [0|0] "" Vector__XXX

BA_DEF_  "BusType" STRING ;
BA_DEF_DEF_  "BusType" "CAN";
